## exercises/yocto-custom/meta-chap06/conf/layer.conf
```bitbake
# We have a conf and classes directory, add to BBPATH 
BBPATH := "${BBPATH}:${LAYERDIR}" 
# We have a packages directory, add to BBFILES 
BBFILES := "${BBFILES} ${LAYERDIR}/recipes-*/*/*.bb \ 
            ${LAYERDIR}/recipes-*/*/*.bbappend" 
BBFILE_COLLECTIONS += "chap06" 
BBFILE_PATTERN_chap06 := "^${LAYERDIR}/" 
BBFILE_PRIORITY_chap06 := "5"
```
